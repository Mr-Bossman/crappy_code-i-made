#include <spi4teensy3.h>

int pre= 360;
volatile uint16_t pwmbuffer[72];
uint32_t commands;
volatile uint64_t last = 0;
volatile unsigned int t = 0;
void time() {
uint64_t tmp = micros();
t = (tmp - last)/pre;
last = tmp;
}
void rite(){

    noInterrupts();
  for (uint8_t n = 0; n < 6; n++) {
    spi4teensy3::send(commands >> 24);
    spi4teensy3::send(commands >> 16);
    spi4teensy3::send(commands >> 8);
    spi4teensy3::send(commands);

    // 12 channels per TLC59711
    for (int8_t c = 11; c >= 0; c--) {
      // 16 bits per channel, send MSB first
     spi4teensy3::send(pwmbuffer[n * 12 + c] >> 8);
      spi4teensy3::send(pwmbuffer[n * 12 + c]);
    }
  }
    interrupts();
  //}
}

const PROGMEM  uint8_t lester[360][72] = {10,0,0,255,255,255,255,255,255,255,255,255,255,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0,0};

void setup() {
  spi4teensy3::init(1,MODE_TO_SPI4TEENSY3_MODE(0));
  pinMode(8, INPUT);
 // Serial.begin(9600);
  commands = 0x25;

  commands <<= 5;
  // OUTTMG = 1, EXTGCK = 0, TMGRST = 1, DSPRPT = 1, BLANK = 0 -> 0x16
  commands |= 0x16;

  commands <<= 7;
  commands |= 0x7F;

  commands <<= 7;
  commands |= 0x7F;

  commands <<= 7;
  commands |= 0x7F;
  attachInterrupt(digitalPinToInterrupt(8), time, RISING);

}

void loop() {
if(digitalRead(8)==HIGH){
  for(int deg = 0; deg <pre; deg++){
    while(last+((t-1)*deg) > micros());
      for(uint8_t i=0; i<72; i++) {
        pwmbuffer[i]= lester[deg][i]<<8;
      }
      rite(); 
      
    /*
      for (int Pinl = 0; Pinl <=2; Pinl++) {
        for (int Pin = 0; Pin <=4; Pin++)digitalWriteFast(Pin, LOW);
        digitalWriteFast(Pinl+5, LOW);
        for (int Pin = 0; Pin <=4; Pin++) {
          if(lester[deg][Pin+(Pinl*5)]){
            digitalWriteFast(Pin, HIGH);
          }else{
            digitalWriteFast(Pin, LOW);
          }
        }
        delayMicroseconds(10);
        digitalWriteFast(Pinl+5, HIGH);
      }*/
      
    }
    //delayMicroseconds(t);
 }
  /*digitalWrite(7, HIGH);
  delayMicroseconds(t);
  digitalWrite(7, LOW);
  delayMicroseconds(t*359);*/
}

