/* LED Blink, Teensyduino Tutorial #1
   http://www.pjrc.com/teensy/tutorial.html
 
   This example code is in the public domain.
*/

// Teensy 2.0 has the LED on pin 11
// Teensy++ 2.0 has the LED on pin 6
// Teensy 3.x / Teensy LC have the LED on pin 13
int pre= 360;
bool lester[360][15] = {1,1,1,1,1,1,1,0,0,0,0,1,1,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1,1};
int last = 0;
int t = 0;
void setup() {
  for (int Pin = 0; Pin <=7; Pin++) {
    pinMode(Pin, OUTPUT);}
  pinMode(8, INPUT);
  Serial.begin(9600);
  attachInterrupt(digitalPinToInterrupt(8), time, RISING);
}

void loop() {
if(digitalRead(8)==HIGH){
  for(int deg = 0; deg <pre; deg++){
    while(last+(t*deg) > micros()){
      for (int Pinl = 0; Pinl <=2; Pinl++) {
        for (int Pin = 0; Pin <=4; Pin++)digitalWriteFast(Pin, LOW);
        digitalWriteFast(Pinl+5, LOW);
        for (int Pin = 0; Pin <=4; Pin++) {
          if(lester[deg][Pin+(Pinl*5)]){
            digitalWriteFast(Pin, HIGH);
          }else{
            digitalWriteFast(Pin, LOW);
          }
        }
        delayMicroseconds(10);
        digitalWriteFast(Pinl+5, HIGH);
      }
      
    }
    //delayMicroseconds(t);
  }
  /*digitalWrite(7, HIGH);
  delayMicroseconds(t);
  digitalWrite(7, LOW);
  delayMicroseconds(t*359);*/}
}
void time() {
int tmp = micros();
t = (tmp - last)/pre;
last = tmp;
}

